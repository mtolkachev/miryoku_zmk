// Copyright 2021 Manna Harbour
// https://github.com/manna-harbour/miryoku

CONFIG_ZMK_BEHAVIOR_UNICODE=y

#include "../miryoku/custom_config.h"
#include "../miryoku/mapping/42/corne.h"
#include "../miryoku/miryoku.dtsi"
